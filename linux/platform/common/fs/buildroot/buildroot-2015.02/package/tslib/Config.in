## linux/platform/common/fs/buildroot/buildroot-2015.02/package/tslib/Config.in
```kconfig
config BR2_PACKAGE_TSLIB
	bool "tslib"
	depends on !BR2_STATIC_LIBS # dlopen
	help
	  Tslib is an abstraction layer for touchscreen panel events.

	  https://github.com/kergoth/tslib

comment "tslib needs a toolchain w/ dynamic library"
	depends on BR2_STATIC_LIBS

if BR2_PACKAGE_TSLIB

choice
	prompt "touch point type"
	default BR2_PACKAGE_TSLIB_LEGACY

config BR2_PACKAGE_TSLIB_LEGACY
	bool "single point"
	help
		None.

config BR2_PACKAGE_TSLIB_MULTI
	bool "multiple point"
	help
		None.
endchoice

endif
```
